/**
 * @cliArgs --board "/ti/boards/CC3220S_LAUNCHXL" --rtos "tirtos7" --product "simplelink_cc32xx_sdk@6.10.00.05"
 * @versions {"tool":"1.14.0+2667"}
 */

/**
 * Import the modules used in this configuration.
 */
const GPIO        = scripting.addModule("/ti/drivers/GPIO");
const GPIO1       = GPIO.addInstance();
const GPIO2       = GPIO.addInstance();
const GPIO3       = GPIO.addInstance();
const GPIO4       = GPIO.addInstance();
const GPIO5       = GPIO.addInstance();
const PWM         = scripting.addModule("/ti/drivers/PWM", {}, false);
const PWM1        = PWM.addInstance();
const Power       = scripting.addModule("/ti/drivers/Power");
const UART2       = scripting.addModule("/ti/drivers/UART2", {}, false);
const UART21      = UART2.addInstance();
const Settings    = scripting.addModule("/ti/posix/tirtos/Settings");
const BIOS        = scripting.addModule("/ti/sysbios/BIOS");
const Event       = scripting.addModule("/ti/sysbios/knl/Event");
const Idle        = scripting.addModule("/ti/sysbios/knl/Idle", {}, false);
const Idle2       = Idle.addInstance();
const Mailbox     = scripting.addModule("/ti/sysbios/knl/Mailbox");
const Error       = scripting.addModule("/ti/sysbios/runtime/Error");
const SysCallback = scripting.addModule("/ti/sysbios/runtime/SysCallback");
const Timestamp   = scripting.addModule("/ti/sysbios/runtime/Timestamp");

/**
 * Write custom configuration values to the imported modules.
 */
GPIO1.$hardware = system.deviceData.board.components.LED_RED;
GPIO1.$name     = "LED_RED";

GPIO2.$hardware = system.deviceData.board.components.LED_GREEN;
GPIO2.$name     = "LED_GREEN";

GPIO3.$name     = "LED_YELLOW";
GPIO3.$hardware = system.deviceData.board.components.LED_YELLOW;

GPIO4.$hardware        = system.deviceData.board.components.SW2;
GPIO4.$name            = "BUTTON_2";
GPIO4.interruptTrigger = "Rising Edge";
GPIO4.pull             = "Pull Up";

GPIO5.$name            = "BUTTON_3";
GPIO5.$hardware        = system.deviceData.board.components.SW3;
GPIO5.interruptTrigger = "Rising Edge";
GPIO5.pull             = "Pull Up";

PWM1.$name = "CONFIG_PWM_0";

Power.parkPins.$name = "ti_drivers_power_PowerCC32XXPins0";

UART21.$name     = "CONFIG_UART2_0";
UART21.$hardware = system.deviceData.board.components.XDS110UART;

BIOS.assertsEnabled = false;
BIOS.heapBaseAddr   = "__primary_heap_start__";
BIOS.heapEndAddr    = "__primary_heap_end__";

const Hwi           = scripting.addModule("/ti/sysbios/family/arm/m3/Hwi", {}, false);
Hwi.enableException = false;

Idle2.$name   = "powerIdle";
Idle2.idleFxn = "Power_idleFunc";

const Semaphore            = scripting.addModule("/ti/sysbios/knl/Semaphore", {}, false);
Semaphore.supportsPriority = false;

const Task             = scripting.addModule("/ti/sysbios/knl/Task", {}, false);
Task.checkStackFlag    = false;
Task.defaultStackSize  = 512;
Task.idleTaskStackSize = 512;

Error.policy       = "Error_SPIN";
Error.printDetails = false;

const System           = scripting.addModule("/ti/sysbios/runtime/System", {}, false);
System.abortFxn        = "System_abortSpin";
System.exitFxn         = "System_exitSpin";
System.extendedFormats = "%f";
System.supportModule   = "SysCallback";

/**
 * Pinmux solution for unlocked pins/peripherals. This ensures that minor changes to the automatic solver in a future
 * version of the tool will not impact the pinmux you originally saw.  These lines can be completely deleted in order to
 * re-solve from scratch.
 */
GPIO1.gpioPin.$suggestSolution            = "boosterpack.29";
GPIO2.gpioPin.$suggestSolution            = "boosterpack.10";
GPIO3.gpioPin.$suggestSolution            = "boosterpack.9";
GPIO4.gpioPin.$suggestSolution            = "boosterpack.3";
GPIO5.gpioPin.$suggestSolution            = "boosterpack.11";
PWM1.timer.$suggestSolution               = "Timer1";
PWM1.timer.pwmPin.$suggestSolution        = "boosterpack.13";
UART21.uart.$suggestSolution              = "UART0";
UART21.uart.txPin.$suggestSolution        = "ball.55";
UART21.uart.txDmaChannel.$suggestSolution = "UDMA_CH9";
UART21.uart.rxPin.$suggestSolution        = "ball.57";
UART21.uart.rxDmaChannel.$suggestSolution = "UDMA_CH8";
